## boards/arm/allwinner/lichee-pi-v3s/configs/nsh/defconfig
```kconfig
CONFIG_EXPERIMENTAL=y
CONFIG_HOST_LINUX=y
CONFIG_APPS_DIR="../apps"
CONFIG_BASE_DEFCONFIG="lichee-pi-v3s:nsh-dirty"
CONFIG_BUILD_FLAT=y
CONFIG_INTELHEX_BINARY=y
CONFIG_RAW_BINARY=y
CONFIG_ARCH_HAVE_STDARG_H=y
CONFIG_ARCH_HAVE_SETJMP=y
CONFIG_ARCH_NONE_DEBUG_H=y
CONFIG_FORTIFY_SOURCE=0
CONFIG_ASSERTIONS_FILENAME=y
CONFIG_DEBUG_ALERT=y
CONFIG_DEBUG_ERROR=y
CONFIG_DEBUG_WARN=y
CONFIG_DEBUG_INFO=y
CONFIG_DEBUG_ASSERTIONS=y
CONFIG_DEBUG_ASSERTIONS_FILENAME=y
CONFIG_DEBUG_SCHED=y
CONFIG_DEBUG_SCHED_ERROR=y
CONFIG_DEBUG_SCHED_WARN=y
CONFIG_DEBUG_SCHED_INFO=y
CONFIG_ARCH_HAVE_STACKCHECK=y
CONFIG_STACK_COLORATION=y
CONFIG_STACK_USAGE_WARNING=0
CONFIG_DEBUG_SYMBOLS=y
CONFIG_ARCH_HAVE_CUSTOMOPT=y
CONFIG_DEBUG_FULLOPT=y
CONFIG_LTO_NONE=y
CONFIG_DEBUG_OPT_UNUSED_SECTIONS=y
CONFIG_DEBUG_LINK_MAP=y
CONFIG_ARCH_ARM=y
CONFIG_ARCH="arm"
CONFIG_ARM_TOOLCHAIN_GNU_EABI=y
CONFIG_ARCH_CHIP_ALLWINNER_V3S_ARM=y
CONFIG_ARCH_ARMV7A=y
CONFIG_ARCH_CORTEXA7=y
CONFIG_ARCH_FAMILY="armv7-a"
CONFIG_ARCH_CHIP="allwinner"
CONFIG_ARCH_BOARD="lichee-pi-v3s"
CONFIG_ARCH_BOARD_LICHEE_PI=y
CONFIG_ARM_HAVE_WFE_SEV=y
CONFIG_ARM_HAVE_MPCORE=y
CONFIG_ARCH_HAVE_LOWVECTORS=y
CONFIG_ARCH_LOWVECTORS=y
CONFIG_ARMV7A_HAVE_GICv2=y
CONFIG_ARMV7A_HAVE_GTM=y
CONFIG_ARMV7A_HAVE_PTM=y
CONFIG_ARCH_CHIP_ALLWINNER_CORTEXA7=y
CONFIG_ARCH_TOOLCHAIN_GNU=y
CONFIG_ARCH_HAVE_IRQTRIGGER=y
CONFIG_ARCH_HAVE_IRQPRIO=y
CONFIG_ARCH_ICACHE=y
CONFIG_ARCH_DCACHE=y
CONFIG_ARCH_HAVE_ADDRENV=y
CONFIG_ARCH_NEED_ADDRENV_MAPPING=y
CONFIG_ARCH_HAVE_MULTICPU=y
CONFIG_ARCH_HAVE_FORK=y
CONFIG_ARCH_HAVE_FPU=y
CONFIG_ARCH_HAVE_MMU=y
CONFIG_ARCH_HAVE_POWEROFF=y
CONFIG_ARCH_HAVE_RESET=y
CONFIG_ARCH_HAVE_TESTSET=y
CONFIG_ARCH_HAVE_THREAD_LOCAL=y
CONFIG_ARCH_HAVE_SYSCALL_HOOKS=y
CONFIG_ARCH_HAVE_BACKTRACE=y
CONFIG_ARCH_HAVE_PERF_EVENTS=y
CONFIG_ARCH_HAVE_CPUINFO=y
CONFIG_ARCH_HAVE_TCBINFO=y
CONFIG_ARCH_FPU=y
CONFIG_ARCH_USE_MMU=y
CONFIG_BOARD_LOOPSPERMSEC=5000
CONFIG_ARCH_HAVE_INTERRUPTSTACK=y
CONFIG_ARCH_INTERRUPTSTACK=2048
CONFIG_ARCH_HAVE_HIPRI_INTERRUPT=y
CONFIG_BOOT_RUNFROMSDRAM=y
CONFIG_ARMV7A_PGTABLE_MAPPING=y
CONFIG_RAM_START=0x41000000
CONFIG_RAM_VSTART=0x41000000
CONFIG_RAM_SIZE=50331648
CONFIG_ARCH_HAVE_IRQBUTTONS=y
CONFIG_BOARDCTL=y
CONFIG_BOARDCTL_MKRD=y
CONFIG_BOARD_MEMORY_RANGE=""
CONFIG_DISABLE_OS_API=y
CONFIG_ARCH_HAVE_TICKLESS=y
CONFIG_USEC_PER_TICK=1000
CONFIG_ARCH_HAVE_TIMEKEEPING=y
CONFIG_START_YEAR=2023
CONFIG_START_MONTH=4
CONFIG_START_DAY=25
CONFIG_PREALLOC_TIMERS=4
CONFIG_SPINLOCK=y
CONFIG_RW_SPINLOCK=y
CONFIG_INIT_ENTRY=y
CONFIG_INIT_ARGS=""
CONFIG_INIT_STACKSIZE=4096
CONFIG_INIT_PRIORITY=100
CONFIG_INIT_ENTRYPOINT="nsh_main"
CONFIG_INIT_ENTRYNAME="nsh_main"
CONFIG_RR_INTERVAL=200
CONFIG_TASK_NAME_SIZE=31
CONFIG_SCHED_WAITPID=y
CONFIG_PTHREAD_MUTEX_ROBUST=y
CONFIG_PTHREAD_MUTEX_DEFAULT_PRIO_NONE=y
CONFIG_PTHREAD_CLEANUP_STACKSIZE=0
CONFIG_SCHED_CPULOAD_NONE=y
CONFIG_SCHED_STACK_RECORD=0
CONFIG_DEV_CONSOLE=y
CONFIG_NFILE_DESCRIPTORS_PER_BLOCK=8
CONFIG_FILE_STREAM=y
CONFIG_NAME_MAX=32
CONFIG_PATH_MAX=256
CONFIG_SIG_PREALLOC_IRQ_ACTIONS=8
CONFIG_PREALLOC_MQ_MSGS=8
CONFIG_PREALLOC_MQ_IRQ_MSGS=8
CONFIG_MQ_MAXMSGSIZE=32
CONFIG_SCHED_WORKQUEUE=y
CONFIG_SCHED_HPWORK=y
CONFIG_SCHED_HPNTHREADS=1
CONFIG_SCHED_HPWORKPRIORITY=192
CONFIG_SCHED_HPWORKSTACKSIZE=4096
CONFIG_DEFAULT_TASK_STACKSIZE=4096
CONFIG_IDLETHREAD_STACKSIZE=4096
CONFIG_PTHREAD_STACK_MIN=256
CONFIG_PTHREAD_STACK_DEFAULT=4096
CONFIG_PID_INITIAL_COUNT=16
CONFIG_ONESHOT=y
CONFIG_ALARM_ARCH=y
CONFIG_DEV_GPIO=y
CONFIG_DEV_GPIO_NSIGNALS=1
CONFIG_DEV_NULL=y
CONFIG_DEV_ZERO=y
CONFIG_DEV_OPTEE_NONE=y
CONFIG_DRVR_MKRD=y
CONFIG_ARCH_HAVE_RDWR_MEM_CPU_RUN=y
CONFIG_NETDEVICES=y
CONFIG_NETDEV_HPWORK_THREAD=y
CONFIG_ARCH_HAVE_SERIAL_TERMIOS=y
CONFIG_SERIAL_UART_ARCH_MMIO=y
CONFIG_SERIAL=y
CONFIG_SERIAL_CONSOLE=y
CONFIG_16550_UART=y
CONFIG_16550_UART0=y
CONFIG_16550_UART0_BASE=0x01C28000
CONFIG_16550_UART0_CLOCK=24000000
CONFIG_16550_UART0_IRQ=32
CONFIG_16550_UART0_BAUD=115200
CONFIG_16550_UART0_PARITY=0
CONFIG_16550_UART0_BITS=8
CONFIG_16550_UART0_2STOP=0
CONFIG_16550_UART0_RXBUFSIZE=16
CONFIG_16550_UART0_TXBUFSIZE=16
CONFIG_16550_UART0_SERIAL_CONSOLE=y
CONFIG_16550_REGINCR=1
CONFIG_16550_REGWIDTH=32
CONFIG_16550_ADDRWIDTH=32
CONFIG_SERIAL_NPOLLWAITERS=4
CONFIG_SYSLOG_MAX_CHANNELS=1
CONFIG_RAMLOG=y
CONFIG_RAMLOG_NONBLOCKING=y
CONFIG_RAMLOG_POLLTHRESHOLD=1
CONFIG_SYSLOG_DEVPATH="/dev/ttyS1"
CONFIG_SYSLOG_DEFAULT=y
CONFIG_ARCH_HAVE_NET=y
CONFIG_NET_WRITE_BUFFERS=y
CONFIG_NET_READAHEAD=y
CONFIG_NET=y
CONFIG_NET_DEFAULT_MIN_PORT=4096
CONFIG_NET_DEFAULT_MAX_PORT=32000
CONFIG_NET_ETH_PKTSIZE=590
CONFIG_NET_GUARDSIZE=2
CONFIG_NET_LL_GUARDSIZE=14
CONFIG_NET_RECV_BUFSIZE=0
CONFIG_NET_SEND_BUFSIZE=0
CONFIG_NET_ETHERNET=y
CONFIG_NETDEV_IFINDEX=y
CONFIG_NET_IPv4=y
CONFIG_NET_PREALLOC_DEVIF_CALLBACKS=16
CONFIG_NET_ALLOC_DEVIF_CALLBACKS=0
CONFIG_NET_SOCKOPTS=y
CONFIG_NET_TCPPROTO_OPTIONS=y
CONFIG_NET_TIMESTAMP=y
CONFIG_NET_BINDTODEVICE=y
CONFIG_NET_PKT=y
CONFIG_NET_PKT_PREALLOC_CONNS=1
CONFIG_NET_PKT_ALLOC_CONNS=0
CONFIG_NET_TCP=y
CONFIG_NET_TCP_KEEPALIVE=y
CONFIG_NET_TCP_PREALLOC_CONNS=8
CONFIG_NET_TCP_ALLOC_CONNS=0
CONFIG_NET_TCP_NPOLLWAITERS=1
CONFIG_NET_TCP_RTO=3
CONFIG_NET_TCP_MAXRTX=8
CONFIG_NET_TCP_MAXSYNRTX=5
CONFIG_NET_TCP_WAIT_TIMEOUT=120
CONFIG_NET_MAX_LISTENPORTS=20
CONFIG_NET_TCP_FAST_RETRANSMIT=y
CONFIG_NET_TCP_WRITE_BUFFERS=y
CONFIG_NET_TCP_NWRBCHAINS=8
CONFIG_NET_SENDFILE=y
CONFIG_NET_UDP=y
CONFIG_NET_UDP_PREALLOC_CONNS=8
CONFIG_NET_UDP_ALLOC_CONNS=0
CONFIG_NET_UDP_NPOLLWAITERS=1
CONFIG_NET_UDP_WRITE_BUFFERS=y
CONFIG_NET_UDP_NWRBCHAINS=8
CONFIG_NET_ARP=y
CONFIG_NET_ARPTAB_SIZE=16
CONFIG_NET_ARP_MAXAGE=120
CONFIG_NET_ARP_SEND=y
CONFIG_ARP_SEND_MAXTRIES=5
CONFIG_ARP_SEND_DELAYMSEC=20
CONFIG_NET_SNOOP_BUFSIZE=4096
CONFIG_NET_RECV_PACK=y
CONFIG_FS_NEPOLL_DESCRIPTORS=8
CONFIG_FS_LOCK_BUCKET_SIZE=0
CONFIG_SENDFILE_BUFSIZE=512
CONFIG_FS_MQUEUE_VFS_PATH="/var/mqueue"
CONFIG_FS_MQUEUE_NPOLLWAITERS=4
CONFIG_FS_ANONMAP=y
CONFIG_FS_ROMFS=y
CONFIG_FS_ROMFS_CACHE_NODE=y
CONFIG_FS_ROMFS_CACHE_FILE_NSECTORS=1
CONFIG_FS_PROCFS=y
CONFIG_FS_PROCFS_MAX_TASKS=128
CONFIG_NXFONTS_PACKEDMSFIRST=y
CONFIG_MM_DEFAULT_MANAGER=y
CONFIG_MM_DEFAULT_ALIGNMENT=0
CONFIG_MM_REGIONS=1
CONFIG_MM_MAP_COUNT_MAX=1024
CONFIG_MM_HEAP_MEMPOOL_THRESHOLD=0
CONFIG_MM_BACKTRACE=-1
CONFIG_MM_FREE_DELAYCOUNT_MAX=0
CONFIG_MM_IOB=y
CONFIG_IOB_NBUFFERS=36
CONFIG_IOB_BUFSIZE=196
CONFIG_IOB_ALIGNMENT=4
CONFIG_IOB_SECTION=""
CONFIG_IOB_NCHAINS=36
CONFIG_IOB_THROTTLE=8
CONFIG_BINFMT_ELF_RELOCATABLE=y
CONFIG_STDIO_BUFFER_SIZE=64
CONFIG_STDIO_LINEBUFFER=y
CONFIG_NUNGET_CHARS=2
CONFIG_LIBC_FLOATINGPOINT=y
CONFIG_LIBC_LONG_LONG=y
CONFIG_ARCH_LOWPUTC=y
CONFIG_LIBC_RAND_ORDER=1
CONFIG_LIBC_HOMEDIR="/"
CONFIG_LIBC_TMPDIR="/tmp"
CONFIG_LIBC_MAX_TMPFILE=32
CONFIG_LIBC_MAX_EXITFUNS=0
CONFIG_POSIX_SPAWN_DEFAULT_STACKSIZE=4096
CONFIG_LIBC_HOSTNAME=""
CONFIG_LIBC_OPEN_MAX=256
CONFIG_LIBC_STRERROR_ERRNUM=y
CONFIG_LIBC_STRSIGNAL=y
CONFIG_TLS_NELEM=0
CONFIG_TLS_TASK_NELEM=0
CONFIG_LIBC_GAISTRERROR_ERRNUM=y
CONFIG_LIBC_FTOK_VFS_PATH="/var/ftok"
CONFIG_LIBC_MEMFD_ERROR=y
CONFIG_BUILTIN=y
CONFIG_SYMTAB_ORDEREDBYNAME=y
CONFIG_STREAM_OUT_BUFFER_SIZE=64
CONFIG_STREAM_HEXDUMP_BUFFER_SIZE=128
CONFIG_LIBM_TOOLCHAIN=y
CONFIG_HAVE_CXX=y
CONFIG_HAVE_CXXINITIALIZE=y
CONFIG_LIBCXXMINI=y
CONFIG_CXX_STANDARD="gnu++17"
CONFIG_EXAMPLES_HELLO=y
CONFIG_EXAMPLES_HELLO_PROGNAME="hello"
CONFIG_EXAMPLES_HELLO_PRIORITY=100
CONFIG_EXAMPLES_HELLO_STACKSIZE=4096
CONFIG_NETUTILS_NETINIT=y
CONFIG_NETINIT_IPADDR=0x0a000002
CONFIG_NETINIT_DRIPADDR=0x0a000001
CONFIG_NETINIT_NETMASK=0xffffff00
CONFIG_NETUTILS_NETLIB=y
CONFIG_NSH_LIBRARY=y
CONFIG_NSH_PROMPT_STRING="nsh> "
CONFIG_NSH_PROMPT_MAX=32
CONFIG_NSH_PROMPT_ENV="PS1"
CONFIG_NSH_PROMPT_SUFFIX="> "
CONFIG_NSH_READLINE=y
CONFIG_NSH_LINELEN=80
CONFIG_NSH_QUOTE=y
CONFIG_NSH_MAXARGUMENTS=7
CONFIG_NSH_ARGCAT=y
CONFIG_NSH_NESTDEPTH=3
CONFIG_NSH_ALIAS=y
CONFIG_NSH_ALIAS_MAX_AMOUNT=1
CONFIG_NSH_BUILTIN_APPS=y
CONFIG_NSH_DISABLE_DATE=y
CONFIG_NSH_DISABLE_LOSMART=y
CONFIG_NSH_DISABLE_LOMTD=y
CONFIG_NSH_DISABLE_MB=y
CONFIG_NSH_DISABLE_MH=y
CONFIG_NSH_DISABLE_MW=y
CONFIG_NSH_DISABLE_TIMEDATECTL=y
CONFIG_NSH_CODECS_BUFSIZE=128
CONFIG_NSH_CMDOPT_HEXDUMP=y
CONFIG_NSH_PROC_MOUNTPOINT="/proc"
CONFIG_NSH_FILEIOSIZE=512
CONFIG_NSH_SYSINITSCRIPT="init.d/rc.sysinit"
CONFIG_NSH_INITSCRIPT="init.d/rcS"
CONFIG_NSH_SCRIPT_REDIRECT_PATH=""
CONFIG_NSH_CONSOLE=y
CONFIG_NSH_ARCHINIT=y
CONFIG_NSH_NETINIT=y
CONFIG_NSH_WGET_BUFF_SIZE=512
CONFIG_SYSTEM_NSH=y
CONFIG_SYSTEM_NSH_PRIORITY=100
CONFIG_SYSTEM_NSH_STACKSIZE=4096
CONFIG_SYSTEM_NSH_PROGNAME="nsh"
CONFIG_SYSTEM_READLINE=y
CONFIG_READLINE_HAVE_EXTMATCH=y
CONFIG_READLINE_ECHO=y
CONFIG_READLINE_CMD_HISTORY=y
CONFIG_READLINE_CMD_HISTORY_LINELEN=80
CONFIG_READLINE_CMD_HISTORY_LEN=16
CONFIG_SYSTEM_SYSTEM=y
CONFIG_SYSTEM_SYSTEM_STACKSIZE=4096
CONFIG_SYSTEM_SYSTEM_PRIORITY=100
CONFIG_TESTING_GETPRIME=y
CONFIG_TESTING_GETPRIME_PROGNAME="getprime"
CONFIG_TESTING_GETPRIME_PRIORITY=50
CONFIG_TESTING_GETPRIME_STACKSIZE=4096
CONFIG_TESTING_GETPRIME_THREAD_PRIORITY=10
CONFIG_TESTING_LTP_STACKSIZE=4096
CONFIG_TESTING_OSTEST=y
CONFIG_TESTING_OSTEST_LOOPS=1
CONFIG_TESTING_OSTEST_STACKSIZE=8192
CONFIG_TESTING_OSTEST_NBARRIER_THREADS=8
CONFIG_TESTING_OSTEST_RR_RANGE=10000
CONFIG_TESTING_OSTEST_RR_RUNS=10
CONFIG_TESTING_OSTEST_FPULOOPS=16
CONFIG_TESTING_OSTEST_FPUMSDELAY=750
CONFIG_TESTING_OSTEST_FPUPRIORITY=100
CONFIG_TESTING_OSTEST_FPUSTACKSIZE=4096
CONFIG_TESTING_OSTEST_WAITRESULT=y
```
